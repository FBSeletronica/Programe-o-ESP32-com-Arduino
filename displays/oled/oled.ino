/*
 * Exemplo para o display OLED SSD1306 com ESP32
 * 
 * descrição: Este código é um exemplo de como utilizar o display OLED SSD1306 com o ESP32 e a biblioteca Adafruit_SSD1306
 * objetivo: Demonstrar como utilizar o display OLED SSD1306 com o ESP32 para exibir informações de data, hora, temperatura e umidade
 *  
 * 
 * Este código é parte do curso "Programe o ESP32 com Arduino" da Embarcados: https://cursos.embarcados.com.br/cursos/franzininho-wifi-arduino-ide/
  *  
 * Autor: Fábio Souza
 * data: 06/09/2023
 */

#include <Wire.h>
#include <Adafruit_GFX.h>
#include <Adafruit_SSD1306.h>

// Defina o endereço I2C do display OLED
#define SSD1306_I2C_ADDRESS 0x3C

// Defina a largura e altura do display OLED
#define SCREEN_WIDTH 128
#define SCREEN_HEIGHT 64

// Crie uma instância do display
Adafruit_SSD1306 display(SCREEN_WIDTH, SCREEN_HEIGHT, &Wire, -1);

// Variáveis para simular a hora
int hora = 14;
int minuto = 30;
int segundo = 45;


// Imagem do logo da Franzininho
#define imageWidth 128
#define imageHeight 64
const unsigned char franzininho_logo_128x64 [] PROGMEM = {
  0x00, 0x00, 0x00, 0x00, 0x00, 0x00, 0x00, 0x00, 0x00, 0x00, 0x00, 0x00, 0x00, 0x00, 0x00, 0x00, 
  0x00, 0x00, 0x00, 0x00, 0x00, 0x00, 0x00, 0x00, 0x00, 0x00, 0x00, 0x00, 0x00, 0x00, 0x00, 0x00, 
  0x00, 0x00, 0x00, 0x00, 0x00, 0x00, 0x00, 0x00, 0x00, 0x00, 0x00, 0x00, 0x00, 0x00, 0x00, 0x00, 
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  0x00, 0x00, 0x00, 0x00, 0x00, 0x00, 0x00, 0x00, 0x00, 0x00, 0x00, 0x00, 0x00, 0x00, 0x00, 0x00
};

void setup() {
  // Inicialize a comunicação I2C
  Wire.begin();

  // Inicialize o display com o endereço I2C
  if(!display.begin(SSD1306_SWITCHCAPVCC, SSD1306_I2C_ADDRESS)) {
    Serial.println(F("SSD1306 allocation failed"));
    for(;;);
  }

  // Limpe o buffer do display
  display.clearDisplay();

  // Mostra o logo da Franzininho como splash screen
  display.clearDisplay();
  display.drawBitmap(0, 0, franzininho_logo_128x64, imageWidth, imageHeight, WHITE);
  display.display();

  // Aguarde 2 segundos
  delay(2000);

  // Limpe o buffer do display
  display.clearDisplay();

  // Defina a cor do texto
  display.setTextColor(SSD1306_WHITE);
}

void loop() {
  // Limpe o buffer do display
  display.clearDisplay();

  // Defina a posição inicial do cursor para a data e outras informações
  display.setCursor(0, 0);
  display.setTextSize(1);

  // Exibe a data
  display.print("Date: ");
  display.print("12/10/2023");
  display.println();

  // Exibe a temperatura
  display.print("Temp: ");
  display.print("25.3 ");
  display.write(247);
  display.println("C");

  // Exibe a umidade
  display.print("Umid: ");
  display.print("60");
  display.println(" %");

  display.setCursor(10, 40);    // Posição inicial do cursor para a hora
  display.setTextSize(2);       // Tamanho do texto

  // Exibe a hora
  display.print(hora <10 ? "0" : "");
  display.print(hora);
  display.print(":");
  display.print(minuto <10 ? "0" : "");
  display.print(minuto);
  display.print(":");
  display.print(segundo <10 ? "0" : "");
  display.print(segundo);

  // Atualize o display com o conteúdo do buffer
  display.display();

  // Aguarda um segundo antes de atualizar novamente
  delay(1000);

  // Atualiza a hora
  segundo++;
  if(segundo>=60)
  {
    segundo=0;
    minuto++;
    if(minuto>=60)
    {
      minuto = 0;
      hora++;
      if(hora>=24)
      {
        hora = 0;
      }
    }
  }
}
